## module/dts/bindings/ps2/gpio-ps2.yaml
```yaml
# Copyright (c) 2019, Intel Corporation
# SPDX-License-Identifier: Apache-2.0

description: GPIO PS2

compatible: "gpio-ps2"

include: base.yaml

properties:
    scl-gpios:
      type: phandle-array
      required: true
      description: GPIO to which the PS/2 clock (SCL) line is connected.
    sda-gpios:
      type: phandle-array
      required: true
      description: GPIO to which the PS/2 data (SDA) line is connected.
```
