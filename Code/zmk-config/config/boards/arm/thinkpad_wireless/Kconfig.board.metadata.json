## Code/zmk-config/config/west.yml
```yaml
manifest:
  remotes:
    - name: tails-dev
      url-base: https://github.com/tails-dev
    - name: zmkfirmware
      url-base: https://github.com/zmkfirmware
  projects:
    - name: kb_zmk_ps2_mouse_trackpoint_driver
      remote: tails-dev
      revision: main
    - name: zmk
      remote: zmkfirmware
      revision: main
      import: app/west.yml
  self:
    path: config
```

## config/boards/arm/thinkpad_wireless/thinkpad_wireless_defconfig
```kconfig
# Copyright (c) 2024 The ZMK Contributors
# SPDX-License-Identifier: MIT

CONFIG_SOC_SERIES_NRF52X=y
CONFIG_SOC_NRF52840_QIAA=y
CONFIG_BOARD_THINKPAD_WIRELESS=y

# Enable ZMK
CONFIG_ZMK_KEYBOARD_NAME="Thinkpad Wireless"

# Enable Bluetooth
CONFIG_ZMK_BLE=y

# Power Management
CONFIG_ZMK_SLEEP=y
CONFIG_ZMK_IDLE_SLEEP_TIMEOUT=900000

# Battery
CONFIG_ZMK_BATTERY_REPORTING=y

# External Power Control (5V Boost)
CONFIG_ZMK_EXT_POWER=y

# Enable ADC for battery voltage measurement
CONFIG_ADC=y

# Enable Mouse Pointing for TrackPoint
CONFIG_ZMK_POINTING=y
```

## config/boards/thinkpad_wireless/Kconfig.defconfig
```kconfig
# Copyright (c) 2024 The ZMK Contributors
# SPDX-License-Identifier: MIT

if BOARD_THINKPAD_WIRELESS

# Name must be 16 characters or less
config ZMK_KEYBOARD_NAME
    default "ThinkpadWireless"

endif # BOARD_THINKPAD_WIRELESS
```

## config/boards/thinkpad_wireless/Kconfig.thinkpad_wireless
```kconfig
# Copyright (c) 2024 The ZMK Contributors
# SPDX-License-Identifier: MIT

config BOARD_THINKPAD_WIRELESS
    bool "Thinkpad Wireless Keyboard"
    select SOC_NRF52840_QIAA

# TrackPoint PS/2 Driver Configurations
config PS2
    bool
    default y if ZMK_INPUT_MOUSE_PS2

config ZMK_INPUT_MOUSE_PS2
    bool "Enable ZMK PS/2 Mouse/TrackPoint driver"
    depends on (!ZMK_SPLIT || ZMK_SPLIT_ROLE_CENTRAL)
    select ZMK_POINTING
    select ZMK_POINTING_SMOOTH_SCROLLING
    select PS2
    default y if $(dt_compat_enabled,zmk,input-mouse-ps2)

config ZMK_INPUT_LISTENER_PS2
    bool "Enable PS/2 mouse input listener"
    default y if $(dt_compat_enabled,zmk,input-listener)

config ZMK_BEHAVIOR_MOUSE_SETTING
    bool "Enable mouse setting behaviors"
    default y if ZMK_INPUT_MOUSE_PS2 && $(dt_compat_enabled,zmk,behavior-mouse-setting)

config PS2_GPIO
    bool "GPIO bit banging PS/2 support"
    default y if $(dt_compat_enabled,gpio-ps2)

config PS2_UART
    bool "GPIO bit banging PS/2 support through UART"
    default y if $(dt_compat_enabled,uart-ps2)
    select SERIAL
    select UART_ASYNC_API
    select UART_USE_RUNTIME_CONFIGURE

if PS2_GPIO
config BT_CTLR_ADVANCED_FEATURES
    default y
config BT_CTLR_LLL_PRIO
    default 1
config BT_CTLR_ULL_HIGH_PRIO
    default 2
config BT_CTLR_ULL_LOW_PRIO
    default 2
endif

if PS2_UART
config PM_DEVICE
    default y
config BT_CTLR_ADVANCED_FEATURES
    default y
config BT_CTLR_LLL_PRIO
    default 1
config BT_CTLR_ULL_HIGH_PRIO
    default 2
config BT_CTLR_ULL_LOW_PRIO
    default 2
endif
```

## config/boards/thinkpad_wireless/thinkpad_wireless_defconfig
```kconfig
# Copyright (c) 2024 The ZMK Contributors
# SPDX-License-Identifier: MIT


# Enable ZMK

# Enable Bluetooth
CONFIG_ZMK_BLE=y

# Power Management
CONFIG_ZMK_SLEEP=y
CONFIG_ZMK_IDLE_SLEEP_TIMEOUT=900000

# Battery
CONFIG_ZMK_BATTERY_REPORTING=y

# External Power Control (5V Boost)
CONFIG_ZMK_EXT_POWER=y

# Enable ADC for battery voltage measurement
CONFIG_ADC=y

# Enable Mouse Pointing for TrackPoint
CONFIG_ZMK_POINTING=y

# HID Indicators (Caps Lock LED)
CONFIG_ZMK_HID_INDICATORS=y

# Enable PWM for breathing power LED
CONFIG_PWM=y

# Enable poweroff subsystem
CONFIG_POWEROFF=y

# PS2 & Bluetooth Controller Tuning for TrackPoint
CONFIG_PM_DEVICE=y
CONFIG_BT_CTLR_ADVANCED_FEATURES=y
CONFIG_BT_CTLR_LLL_PRIO=1
CONFIG_BT_CTLR_ULL_HIGH_PRIO=2
CONFIG_BT_CTLR_ULL_LOW_PRIO=2

# Bluetooth Name Fix
CONFIG_ZMK_KEYBOARD_NAME="Thinkpad Wireless"
CONFIG_BT_DEVICE_NAME_MAX=32
```

## module/boards/thinkpad/thinkpad_wireless/Kconfig.defconfig
```kconfig
# Copyright (c) 2024 The ZMK Contributors
# SPDX-License-Identifier: MIT
#
# Kconfig.defconfig: Hardware-level defaults for the thinkpad_wireless board.
# User preferences (keyboard name, sleep timeouts, etc.) go in
# config/thinkpad_wireless.conf instead.

if BOARD_THINKPAD_WIRELESS

# nRF52840 hardware requires these for proper operation
config BT_DEVICE_NAME_MAX
    default 32

endif # BOARD_THINKPAD_WIRELESS
```

## module/boards/thinkpad/thinkpad_wireless/Kconfig.thinkpad_wireless
```kconfig
# Copyright (c) 2024 The ZMK Contributors
# SPDX-License-Identifier: MIT

config BOARD_THINKPAD_WIRELESS
    bool "Thinkpad Wireless Keyboard"
    select SOC_NRF52840_QIAA
```

## module/boards/thinkpad/thinkpad_wireless/board.yml
```yaml
board:
  name: thinkpad_wireless
  vendor: thinkpad
  socs:
    - name: nrf52840
```

## module/boards/thinkpad/thinkpad_wireless/thinkpad_wireless_defconfig
```kconfig
# Copyright (c) 2024 The ZMK Contributors
# SPDX-License-Identifier: MIT
#
# thinkpad_wireless_defconfig: Hardware-level Kconfig for the thinkpad_wireless board.
# This file sets hardware-specific options that are always required for this board.
# User preferences (BLE name, sleep timeouts, features) are in config/thinkpad_wireless.conf.

# Enable ADC for battery voltage measurement (hardware requirement)
CONFIG_ADC=y
CONFIG_ADC_NRFX_SAADC=y

# Enable PWM for breathing power LED (hardware requirement)
CONFIG_PWM=y

# PS/2 & Bluetooth Controller Tuning for TrackPoint coexistence
CONFIG_PM_DEVICE=y
CONFIG_BT_CTLR_ADVANCED_FEATURES=y
CONFIG_BT_CTLR_LLL_PRIO=1
CONFIG_BT_CTLR_ULL_HIGH_PRIO=2
CONFIG_BT_CTLR_ULL_LOW_PRIO=2

# Set BT device name to satisfy ZMK's default BT_DEVICE_NAME_MAX of 16.
# Since the board name "thinkpad_wireless" (17 chars) is too long for the default
# BT GAP name (which must be < BT_DEVICE_NAME_MAX, i.e., <= 15 chars).
CONFIG_BT_DEVICE_NAME="ThinkpadWL"
```

## zmk-config/config/boards/arm/thinkpad_wireless/thinkpad_wireless_defconfig
```kconfig
# Copyright (c) 2024 The ZMK Contributors
# SPDX-License-Identifier: MIT

CONFIG_SOC_SERIES_NRF52X=y
CONFIG_SOC_NRF52840_QIAA=y
CONFIG_BOARD_THINKPAD_WIRELESS=y

# Enable ZMK
CONFIG_ZMK_KEYBOARD_NAME="Thinkpad Wireless"

# Enable Bluetooth
CONFIG_ZMK_BLE=y

# Power Management
CONFIG_ZMK_SLEEP=y
CONFIG_ZMK_IDLE_SLEEP_TIMEOUT=900000

# Battery
CONFIG_ZMK_BATTERY_REPORTING=y
```
